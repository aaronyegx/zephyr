/*
 * Copyright (c) 2023 Antmicro <www.antmicro.com>
 *
 * SPDX-License-Identifier: Apache-2.0
 */

 / {
	resources {
		compatible = "test-gpio-basic-api";
		out-gpios = <&gpio0_31 12 0>;
		in-gpios = <&gpio0_31 13 0>;
	};
};
