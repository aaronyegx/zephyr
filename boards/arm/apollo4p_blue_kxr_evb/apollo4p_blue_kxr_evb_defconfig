## boards/arm/apollo4p_blue_kxr_evb/apollo4p_blue_kxr_evb_defconfig
```kconfig
# SPDX-License-Identifier: Apache-2.0
#
# Copyright (c) 2023 Ambiq Micro Inc. <www.ambiq.com>

CONFIG_SOC_SERIES_APOLLO4X=y
CONFIG_SOC_APOLLO4P_BLUE=y
CONFIG_CONSOLE=y
CONFIG_UART_CONSOLE=y
CONFIG_SERIAL=y
CONFIG_UART_INTERRUPT_DRIVEN=y
CONFIG_BT_AMBIQ_HCI=y

# Apollo4 Blue Plus BLE Controller does not support
# the ACL flow control.
CONFIG_BT_HCI_ACL_FLOW_CONTROL=n
```

## drivers/clock_control/Kconfig.ambiq
```kconfig
# Ambiq Clock Driver configuration options
#
# Copyright (c) 2023 Ambiq Micro Inc. <www.ambiq.com>
#
# SPDX-License-Identifier: Apache-2.0
#

config CLOCK_CONTROL_AMBIQ
	bool "AMBIQ Clock driver"
	default y
	select AMBIQ_HAL
	help
	  Enable driver for Ambiq clock.
```

## dts/bindings/bluetooth/ambiq,bt-hci-spi.yaml
```yaml
# Copyright (c) 2023, Ambiq Micro Inc.
# SPDX-License-Identifier: Apache-2.0

description: |
    Bluetooth module that uses Ambiq's Bluetooth Host Controller Interface SPI
    driver.

compatible: "ambiq,bt-hci-spi"

properties:
  irq-gpios:
    type: phandle-array
    required: true

  reset-gpios:
    type: phandle-array
    required: true

  clkreq-gpios:
    type: phandle-array
    required: true

  cs-gpios:
    type: phandle-array
    required: true

  reset-assert-duration-ms:
    type: int
    description:
      Minimum duration to hold the reset-gpios pin low for.
      If not specified no delay beyond the code path execution time is guaranteed.
```
